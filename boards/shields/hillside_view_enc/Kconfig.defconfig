## boards/shields/hillside_view_enc/Kconfig.defconfig
```kconfig
# Copyright (c) 2022 The ZMK Contributors
# SPDX-License-Identifier: MIT

if SHIELD_HILLSIDE_VIEW_ENC_LEFT

config ZMK_KEYBOARD_NAME
    default "Hillside View Enc"

config ZMK_SPLIT_ROLE_CENTRAL
    default y

config ZMK_SPLIT_BLE_CENTRAL_PERIPHERALS
    default 1

config BT_MAX_CONN
    default 6

config BT_MAX_PAIRED
    default 6

endif # SHIELD_HILLSIDE_VIEW_ENC_LEFT

if SHIELD_HILLSIDE_VIEW_ENC_LEFT || SHIELD_HILLSIDE_VIEW_ENC_RIGHT

config ZMK_SPLIT
    default y

config ZMK_RGB_UNDERGLOW
    select WS2812_STRIP
    select SPI

config ZMK_DISPLAY
    select LV_FONT_MONTSERRAT_26

if ZMK_DISPLAY

config ZMK_DISPLAY_BLANK_ON_IDLE
  default n

config SPI
    default y

config LS0XX
    default y

config LV_Z_BITS_PER_PIXEL
    default 1

choice LV_COLOR_DEPTH
    default LV_COLOR_DEPTH_1
endchoice

endif # ZMK_DISPLAY

if LVGL

config LV_Z_VDB_SIZE
    default 64

config LV_DPI_DEF
    default 148

config LV_Z_BITS_PER_PIXEL
    default 1

choice LV_COLOR_DEPTH
    default LV_COLOR_DEPTH_1

endchoice

endif # LVGL

endif # SHIELD_HILLSIDE_VIEW_ENC_LEFT || SHIELD_HILLSIDE_VIEW_ENC_RIGHT
```

## boards/shields/hillside_view_enc/Kconfig.shield
```kconfig
# Copyright (c) 2022 The ZMK Contributors
# SPDX-License-Identifier: MIT

config SHIELD_HILLSIDE_VIEW_ENC_LEFT
    def_bool $(shields_list_contains,hillside_view_enc_left)

config SHIELD_HILLSIDE_VIEW_ENC_RIGHT
    def_bool $(shields_list_contains,hillside_view_enc_right)
```

## config/boards/shields/cygnus/Kconfig.defconfig
```kconfig
# the central side is overriden by cmake args
if SHIELD_CYGNUS_DONGLE || SHIELD_CYGNUS_LEFT

config ZMK_KEYBOARD_NAME
    default "Cygnus"

config ZMK_SPLIT_ROLE_CENTRAL
    default y

# Set this to the number of peripherals your dongle will have.
# For a unibody, this would be 1. If you have left and right halves, set it to 2, etc.
config ZMK_SPLIT_BLE_CENTRAL_PERIPHERALS
    default 2

# Set this to ZMK_SPLIT_BLE_CENTRAL_PERIPHERALS + your desired number of BT profiles (default is 5)
config BT_MAX_CONN
    default 6

# Set this to the same number as BT_MAX_CONN
config BT_MAX_PAIRED
    default 6
endif

if SHIELD_CYGNUS_LEFT 
config ZMK_SPLIT_BLE_CENTRAL_PERIPHERALS
    default 1
endif

if SHIELD_CYGNUS_LEFT || SHIELD_CYGNUS_RIGHT || SHIELD_CYGNUS_DONGLE

config ZMK_SPLIT
    default y

config ZMK_BLE
    default y

config ZMK_SPLIT_BLE
    default y

endif
```

## config/boards/shields/cygnus/Kconfig.shield
```kconfig
# Copyright (c) 2025 mike1808
# SPDX-License-Identifier: MIT

config SHIELD_CYGNUS_DONGLE
    def_bool $(shields_list_contains,cygnus_dongle)

config SHIELD_CYGNUS_LEFT
    def_bool $(shields_list_contains,cygnus_left)

config SHIELD_CYGNUS_RIGHT
    def_bool $(shields_list_contains,cygnus_right)
```

## config/boards/shields/hillside_view/Kconfig.defconfig
```kconfig
# Copyright (c) 2022 The ZMK Contributors
# SPDX-License-Identifier: MIT

if SHIELD_HILLSIDE_VIEW_LEFT

config ZMK_KEYBOARD_NAME
    default "Hillside View"

config ZMK_SPLIT_ROLE_CENTRAL
    default y

config ZMK_USB
    default y

endif # SHIELD_HILLSIDE_VIEW_LEFT

if SHIELD_HILLSIDE_VIEW_LEFT || SHIELD_HILLSIDE_VIEW_RIGHT

config ZMK_SPLIT
    default y

config ZMK_RGB_UNDERGLOW
    select WS2812_STRIP
    select SPI

config ZMK_DISPLAY
    select LV_FONT_MONTSERRAT_26

if ZMK_MOUSE

config SPI
  default y

endif # ZMK_MOUSE

if ZMK_DISPLAY

config ZMK_DISPLAY_BLANK_ON_IDLE
  default n

config SPI
    default y

config LS0XX
    default y

# config ZMK_WIDGET_WPM_STATUS
#   default y if !ZMK_SPLIT || ZMK_SPLIT_ROLE_CENTRAL

config LV_Z_BITS_PER_PIXEL
    default 1

choice LV_COLOR_DEPTH
    default LV_COLOR_DEPTH_1
endchoice

endif # ZMK_DISPLAY

if LVGL

config LV_Z_VDB_SIZE
    default 64

config LV_DPI_DEF
    default 148

config LV_Z_BITS_PER_PIXEL
    default 1

choice LV_COLOR_DEPTH
    default LV_COLOR_DEPTH_1

endchoice

endif # LVGL

endif # SHIELD_HILLSIDE_VIEW_LEFT || SHIELD_HILLSIDE_VIEW_RIGHT
```

## config/boards/shields/hillside_view/Kconfig.shield
```kconfig
# Copyright (c) 2022 The ZMK Contributors
# SPDX-License-Identifier: MIT

config SHIELD_HILLSIDE_VIEW_LEFT
	def_bool $(shields_list_contains,hillside_view_left)

config SHIELD_HILLSIDE_VIEW_RIGHT
	def_bool $(shields_list_contains,hillside_view_right)
```

## config/west.yml
```yaml
manifest:
  remotes:
    - name: zmkfirmware
      url-base: https://github.com/zmkfirmware
    - name: badjeff
      url-base: https://github.com/badjeff
    - name: carrefinho
      url-base: https://github.com/carrefinho
    - name: mike1808
      url-base: https://github.com/mike1808
    - name: janpfischer
      url-base: https://github.com/janpfischer
    - name: m165437
      url-base: https://github.com/M165437
  projects:
    - name: zmk
      remote: zmkfirmware
      revision: main
      import: app/west.yml
    # - name: zmk-dongle-screen
    #   remote: janpfischer
    #   revision: upgrade-4.1
    # - name: nice-view-gem
    #   remote: m165437
    #   revision: main
    - name: nice-view-gem
      remote: mike1808
      revision: fix/zmk-endpoint-api
    - name: prospector-zmk-module
      remote: mike1808
      revision: fix/new-status-screan-zmk-refactor
  self:
    path: config
```

## modules/ebook-reader/boards/shields/ebook_reader/Kconfig.defconfig
```kconfig
if SHIELD_EBOOK_READER

config LV_Z_VDB_SIZE
    default 100

config LV_DPI_DEF
    default 161

config LV_Z_BITS_PER_PIXEL
    default 1

choice LV_COLOR_DEPTH
    default LV_COLOR_DEPTH_1
endchoice

choice ZMK_DISPLAY_WORK_QUEUE
    default ZMK_DISPLAY_WORK_QUEUE_DEDICATED
endchoice

choice ZMK_DISPLAY_STATUS_SCREEN
    default ZMK_DISPLAY_STATUS_SCREEN_CUSTOM
endchoice

config LV_Z_MEM_POOL_SIZE
    default 8192

config EBOOK_READER_WIDGET
    bool
    default y
    select LV_USE_LABEL
    select LV_USE_BAR
    select LV_FONT_UNSCII_8
    select LV_USE_ANIMATION

endif # SHIELD_EBOOK_READER
```

## modules/ebook-reader/dts/bindings/behaviors/zmk,behavior-ebook-nav.yaml
```yaml
# Copyright (c) 2024 The ZMK Contributors
# SPDX-License-Identifier: MIT

description: Ebook reader page navigation behavior

compatible: "zmk,behavior-ebook-nav"

include: zero_param.yaml

properties:
  direction:
    type: int
    required: true
    description: Navigation direction (0 = previous page, 1 = next page)
```
