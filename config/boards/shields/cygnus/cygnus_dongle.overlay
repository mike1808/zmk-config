#include <dt-bindings/zmk/matrix_transform.h>
#include "cygnus.dtsi"

/delete-node/ &kscan0;

/ {
    chosen {
        zmk,kscan = &mock_kscan;
    };


    mock_kscan: mock_kscan_0 {
        compatible = "zmk,kscan-mock";
        columns = <0>;
        rows = <0>;
        events = <0>;
    };
};
